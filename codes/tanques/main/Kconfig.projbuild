## codes/tanques/main/Kconfig.projbuild
```kconfig
menu "Kairos Configuration"

config WIFI_SSID
    string "WiFi SSID"
    default "myssid"
    help
        SSID (network name) for the example to connect to.

config WIFI_PASSWORD
    string "WiFi Password"
    default "mypassword"
    help
        WiFi password (WPA or WPA2) for the example to use.

config BROKER_URL
    string "Broker URL"
    default "mqtt://iot.eclipse.org"
    help
        URL of the broker to connect to (mqqts for ssl)

config BROKER_PORT
    string "Broker PORT"
    default 8883
    help
        PORT of the broker to connect to

config BROKER_USER
    string "Broker user name"
    default "user"
    help
        Broker user name

config BROKER_PASS
    string "Broker password"
    default "pass"
    help
        Broker password

config HOST_NAME
    string "Host Name"
    default "host_1"
    help
        host name is used for topics: host_1/temperatura/0

endmenu
```
